#include <SPI.h>
#include <MFRC522.h>
#include <SoftwareSerial.h>
#include <DFRobotDFPlayerMini.h>
#include <Wire.h>
#include <U8g2lib.h>

#define SOUND_START 1
#define SOUND_INSTRUCTIONS 2
#define SOUND_SUCCESS 3
#define SOUND_TRY_AGAIN 4
#define SOUND_TEETH 5
#define SOUND_HANDS 6
#define SOUND_MORNING 7
#define SOUND_SLEEP 8

U8G2_SH1106_128X64_NONAME_1_HW_I2C u8g2(U8G2_R0, U8X8_PIN_NONE);

#define RST_PIN 9
#define SS1 8
#define SS2 7
#define SS3 6

#define LED1 5
#define LED2 4
#define LED3 3
#define BTN 10

MFRC522 r1(SS1, RST_PIN);
MFRC522 r2(SS2, RST_PIN);
MFRC522 r3(SS3, RST_PIN);

SoftwareSerial mp3Serial(A0, A1);
DFRobotDFPlayerMini player;

#define IDLE 0
#define SCANNING 1
#define RESULT 2
byte state = IDLE;

byte currentQuestion = 0;
const byte TOTAL_QUESTIONS = 4;

byte* currentUIDs[3];
byte currentSizes[3];

// 'hands', 128x64px
const unsigned char epd_bitmap_hands [] PROGMEM = {
	0x00, 0x00, 0x00, 0x00, 0x00, 0x00, 0x00, 0x00, 0x00, 0x00, 0x00, 0x00, 0x00, 0x00, 0x00, 0x00, 
	0x00, 0x00, 0x00, 0x00, 0x00, 0x00, 0x00, 0x00, 0x00, 0x00, 0x00, 0x00, 0x00, 0x00, 0x00, 0x00, 
	0x00, 0x00, 0x00, 0x00, 0x00, 0x00, 0x00, 0x00, 0x00, 0x00, 0x00, 0x00, 0x00, 0x00, 0x00, 0x00, 
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	0x00, 0x00, 0x00, 0x00, 0x00, 0x00, 0x00, 0x00, 0x00, 0x00, 0x00, 0x00, 0x00, 0x00, 0x00, 0x00
};
// 'morning', 128x64px
const unsigned char epd_bitmap_morning [] PROGMEM = {
	0x00, 0x00, 0x00, 0x00, 0x00, 0x00, 0x00, 0x00, 0x00, 0x00, 0x00, 0x00, 0x00, 0x00, 0x00, 0x00, 
	0x00, 0x00, 0x00, 0x00, 0x00, 0x00, 0x00, 0x00, 0x00, 0x00, 0x00, 0x00, 0x00, 0x00, 0x00, 0x00, 
	0x00, 0x00, 0x00, 0x00, 0x00, 0x00, 0x00, 0x00, 0x00, 0x00, 0x00, 0x00, 0x00, 0x00, 0x00, 0x00, 
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	0x00, 0x00, 0x00, 0x00, 0x00, 0x00, 0x00, 0x00, 0x00, 0x00, 0x00, 0x00, 0x00, 0x00, 0x00, 0x00
};
// 'next', 128x64px
const unsigned char epd_bitmap_next [] PROGMEM = {
	0x00, 0x00, 0x00, 0x00, 0x00, 0x00, 0x00, 0x00, 0x00, 0x00, 0x00, 0x00, 0x00, 0x00, 0x00, 0x00, 
	0x00, 0x00, 0x00, 0x00, 0x00, 0x00, 0x00, 0x00, 0x00, 0x00, 0x00, 0x00, 0x00, 0x00, 0x00, 0x00, 
	0x00, 0x00, 0x00, 0x00, 0x00, 0x00, 0x00, 0x00, 0x00, 0x00, 0x00, 0x00, 0x00, 0x00, 0x00, 0x00, 
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	0x00, 0x00, 0x00, 0x00, 0x00, 0x00, 0x00, 0x00, 0x00, 0x00, 0x00, 0x00, 0x00, 0x00, 0x00, 0x00
};
// 'sleep', 128x64px
const unsigned char epd_bitmap_sleep [] PROGMEM = {
	0x00, 0x00, 0x00, 0x00, 0x00, 0x00, 0x00, 0x00, 0x00, 0x00, 0x00, 0x00, 0x00, 0x00, 0x00, 0x00, 
	0x00, 0x00, 0x00, 0x00, 0x00, 0x00, 0x00, 0x00, 0x00, 0x00, 0x00, 0x00, 0x00, 0x00, 0x00, 0x00, 
	0x00, 0x00, 0x00, 0x00, 0x00, 0x00, 0x00, 0x00, 0x00, 0x00, 0x00, 0x00, 0x00, 0x00, 0x00, 0x00, 
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	0x00, 0x00, 0x00, 0x00, 0x00, 0x00, 0x00, 0x00, 0x00, 0x00, 0x00, 0x00, 0x00, 0x00, 0x00, 0x00
};
// 'start', 128x64px
const unsigned char epd_bitmap_start [] PROGMEM = {
	0x00, 0x00, 0x00, 0x00, 0x00, 0x00, 0x00, 0x00, 0x00, 0x00, 0x00, 0x00, 0x00, 0x00, 0x00, 0x00, 
	0x00, 0x00, 0x00, 0x00, 0x00, 0x00, 0x00, 0x00, 0x00, 0x00, 0x00, 0x00, 0x00, 0x00, 0x00, 0x00, 
	0x00, 0x00, 0x00, 0x00, 0x00, 0x00, 0x00, 0x00, 0x00, 0x00, 0x00, 0x00, 0x00, 0x00, 0x00, 0x00, 
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	0x00, 0x00, 0x00, 0x00, 0x00, 0x00, 0x00, 0x00, 0x00, 0x00, 0x00, 0x00, 0x00, 0x00, 0x00, 0x00
};
// 'success', 128x64px
const unsigned char epd_bitmap_success [] PROGMEM = {
	0x00, 0x00, 0x00, 0x00, 0x00, 0x00, 0x00, 0x00, 0x00, 0x00, 0x00, 0x00, 0x00, 0x00, 0x00, 0x00, 
	0x00, 0x00, 0x00, 0x00, 0x00, 0x00, 0x00, 0x00, 0x00, 0x00, 0x00, 0x00, 0x00, 0x00, 0x00, 0x00, 
	0x00, 0x00, 0x00, 0x00, 0x00, 0x00, 0x00, 0x00, 0x00, 0x18, 0x00, 0x00, 0x00, 0x00, 0x00, 0x00, 
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	0x00, 0x00, 0x00, 0x00, 0x00, 0x00, 0x00, 0x00, 0x00, 0x00, 0x00, 0x00, 0x00, 0x00, 0x00, 0x00
};
// 'teeth', 128x64px
const unsigned char epd_bitmap_teeth [] PROGMEM = {
	0x00, 0x00, 0x00, 0x00, 0x00, 0x00, 0x00, 0x00, 0x00, 0x00, 0x00, 0x00, 0x00, 0x00, 0x00, 0x00, 
	0x00, 0x00, 0x00, 0x00, 0x00, 0x00, 0x00, 0x00, 0x00, 0x00, 0x00, 0x00, 0x00, 0x00, 0x00, 0x00, 
	0x00, 0x00, 0x00, 0x00, 0x00, 0x00, 0x00, 0x00, 0x00, 0x00, 0x00, 0x00, 0x00, 0x00, 0x00, 0x00, 
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	0x00, 0x00, 0x00, 0x00, 0x00, 0x00, 0x00, 0x00, 0x00, 0x00, 0x00, 0x00, 0x00, 0x00, 0x00, 0x00
};
// 'tryagain', 128x64px
const unsigned char epd_bitmap_tryagain [] PROGMEM = {
	0x00, 0x00, 0x00, 0x00, 0x00, 0x00, 0x00, 0x00, 0x00, 0x00, 0x00, 0x00, 0x00, 0x00, 0x00, 0x00, 
	0x00, 0x00, 0x00, 0x00, 0x00, 0x00, 0x00, 0x00, 0x00, 0x00, 0x00, 0x00, 0x00, 0x00, 0x00, 0x00, 
	0x00, 0x00, 0x00, 0x00, 0x00, 0x00, 0x00, 0x00, 0x00, 0x00, 0x00, 0x00, 0x00, 0x00, 0x00, 0x00, 
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	0x00, 0x00, 0x00, 0x00, 0x00, 0x00, 0x00, 0x00, 0x00, 0x00, 0x00, 0x00, 0x00, 0x00, 0x00, 0x00
};

// Array of all bitmaps for convenience. (Total bytes used to store images in PROGMEM = 8320)
const int epd_bitmap_allArray_LEN = 8;
const unsigned char* epd_bitmap_allArray[8] = {
	epd_bitmap_hands,
	epd_bitmap_morning,
	epd_bitmap_next,
	epd_bitmap_sleep,
	epd_bitmap_start,
	epd_bitmap_success,
	epd_bitmap_teeth,
	epd_bitmap_tryagain
};


void showBitmap(const unsigned char* bitmap) {
  u8g2.firstPage();
  do {
    u8g2.drawXBMP(0, 0, 128, 64, bitmap);
  } while (u8g2.nextPage());
}

bool lastBtn = HIGH;

byte teeth1[] = {0xB9, 0x27, 0xE6, 0x11};
byte teeth2[] = {0x04, 0xCA, 0xE4, 0x6A, 0x78, 0x1D, 0x90};
byte teeth3[] = {0x39, 0xC8, 0x76, 0x12};

byte teethSize[] = {4, 7, 4};

byte hands1[] = {0x04, 0x60, 0xE3, 0x6A, 0x78, 0x1D, 0x90};
byte hands2[] = {0x04, 0x55, 0x71, 0x72, 0x89, 0x1D, 0x91};
byte hands3[] = {0x04, 0x02, 0x7A, 0x72, 0x89, 0x1D, 0x91};

byte handsSize[] = {7, 7, 7};

byte morning1[] = {0x04, 0x39, 0x93, 0x72, 0x89, 0x1D, 0x91};
byte morning2[] = {0x04, 0x1C, 0x6B, 0x72, 0x89, 0x1D, 0x91};
byte morning3[] = {0x04, 0x34, 0x23, 0x72, 0x89, 0x1D, 0x91};

byte morningSize[] = {7, 7, 7};

byte sleep1[] = {0x29, 0x2A, 0xBF, 0x06};
byte sleep2[] = {0x04, 0xE8, 0xE6, 0x6A, 0x78, 0x1D, 0x90};
byte sleep3[] = {0x04, 0x4D, 0x6C, 0x72, 0x89, 0x1D, 0x90};

byte sleepSize[] = {4, 7, 7};

// Αποθηκευμένα UID από κάθε θέση
byte card1[10], card2[10], card3[10];
byte size1 = 0, size2 = 0, size3 = 0;
bool has1 = false, has2 = false, has3 = false;

void setup() {
  Serial.begin(9600);

  pinMode(LED1, OUTPUT);
  pinMode(LED2, OUTPUT);
  pinMode(LED3, OUTPUT);
  pinMode(BTN, INPUT_PULLUP);

  pinMode(SS1, OUTPUT);
  pinMode(SS2, OUTPUT);
  pinMode(SS3, OUTPUT);

  digitalWrite(SS1, HIGH);
  digitalWrite(SS2, HIGH);
  digitalWrite(SS3, HIGH);

  SPI.begin();

  r1.PCD_Init();
  r2.PCD_Init();
  r3.PCD_Init();

  u8g2.begin();

  mp3Serial.begin(9600);
  delay(1500);

  if (player.begin(mp3Serial)) {
    player.volume(25);
    Serial.println(F("DF OK"));
  } else {
    Serial.println(F("DF ERR"));
  }

  showBitmap(epd_bitmap_start);
	//player.play(SOUND_START);
}

void loop() {
  handleButton();

  if (state == SCANNING) {
    scanReader(r1, SS1, card1, size1, has1, LED1, 1);
    scanReader(r2, SS2, card2, size2, has2, LED2, 2);
    scanReader(r3, SS3, card3, size3, has3, LED3, 3);
  }
}

void handleButton() {
  bool btn = digitalRead(BTN);

  if (lastBtn == HIGH && btn == LOW) {
    delay(50);

    if (digitalRead(BTN) == LOW) {
      if (state == IDLE || state == RESULT) {
        startRound();
      } else if (state == SCANNING) {
        checkCards();
      }
    }
  }

  lastBtn = btn;
}

void startRound() {
  state = IDLE;   // σταματάει τελείως το scanning όσο μιλάει

  clearStoredCards();

  digitalWrite(LED1, LOW);
  digitalWrite(LED2, LOW);
  digitalWrite(LED3, LOW);

  showCurrentQuestion();

  delay(300);

  // if (currentQuestion == 0) player.play(SOUND_TEETH);
  // if (currentQuestion == 1) player.play(SOUND_HANDS);
  // if (currentQuestion == 2) player.play(SOUND_MORNING);
  // if (currentQuestion == 3) player.play(SOUND_SLEEP);

  delay(7000);   // βάλε αρκετό χρόνο για να τελειώσει ΟΛΟ το ηχητικό

  clearStoredCards();

  state = SCANNING;
}

void clearStoredCards() {

  has1 = false;
  has2 = false;
  has3 = false;

  size1 = 0;
  size2 = 0;
  size3 = 0;
}

void scanReader(MFRC522 &reader, byte ssPin, byte storedUid[], byte &storedSize, bool &hasCard, byte ledPin, byte readerNum) {
  selectReader(ssPin);

  if (!reader.PICC_IsNewCardPresent()) {
    digitalWrite(ssPin, HIGH);
    return;
  }

  if (!reader.PICC_ReadCardSerial()) {
    digitalWrite(ssPin, HIGH);
    return;
  }

  storedSize = reader.uid.size;

  for (byte i = 0; i < storedSize; i++) {
    storedUid[i] = reader.uid.uidByte[i];
  }

  hasCard = true;
  //digitalWrite(ledPin, HIGH);

  Serial.print(F("R"));
  Serial.print(readerNum);
  Serial.print(F(" SAVED: "));
  printUid(storedUid, storedSize);

  // Δεν κάνουμε HaltA για να μη "κοιμίζουμε" τις NTAG κάρτες
  // reader.PICC_HaltA();
  // reader.PCD_StopCrypto1();

  digitalWrite(ssPin, HIGH);
  delay(20);
}

void checkCards() {
  Serial.println(F("CHECK"));

bool ok1 = compareUid(card1, size1, has1,
                      currentUIDs[0], currentSizes[0]);

bool ok2 = compareUid(card2, size2, has2,
                      currentUIDs[1], currentSizes[1]);

bool ok3 = compareUid(card3, size3, has3,
                      currentUIDs[2], currentSizes[2]);
  digitalWrite(LED1, ok1 ? HIGH : LOW);
  digitalWrite(LED2, ok2 ? HIGH : LOW);
  digitalWrite(LED3, ok3 ? HIGH : LOW);

  if (ok1 && ok2 && ok3) {
  showBitmap(epd_bitmap_success);
  //player.play(SOUND_SUCCESS);

  delay(2000);

  currentQuestion++;

  if (currentQuestion >= TOTAL_QUESTIONS) {
    currentQuestion = 0;
  }

  showBitmap(epd_bitmap_next);
  state = RESULT;
} else {
  showBitmap(epd_bitmap_tryagain);
 // player.play(SOUND_TRY_AGAIN);
  state = SCANNING;
}
}

bool compareUid(byte storedUid[], byte storedSize, bool hasCard, byte correctUid[], byte correctSize) {
  if (!hasCard) return false;
  if (storedSize != correctSize) return false;

  for (byte i = 0; i < correctSize; i++) {
    if (storedUid[i] != correctUid[i]) return false;
  }

  return true;
}

void selectReader(byte ssPin) {
  digitalWrite(SS1, HIGH);
  digitalWrite(SS2, HIGH);
  digitalWrite(SS3, HIGH);
  delay(3);
  digitalWrite(ssPin, LOW);
  delay(3);
}

void printUid(byte uid[], byte uidSize) {
  for (byte i = 0; i < uidSize; i++) {
    if (uid[i] < 0x10) Serial.print(F("0"));
    Serial.print(uid[i], HEX);
    if (i < uidSize - 1) Serial.print(F(":"));
  }
  Serial.println();
}

void showText(const char* line1, const char* line2) {
  u8g2.firstPage();
  do {
    u8g2.setFont(u8g2_font_6x10_tf);
    u8g2.drawStr(10, 24, line1);
    u8g2.drawStr(10, 46, line2);
  } while (u8g2.nextPage());
}

void showCurrentQuestion() {

  if (currentQuestion == 0) {

    showBitmap(epd_bitmap_teeth);

    currentUIDs[0] = teeth1;
    currentUIDs[1] = teeth2;
    currentUIDs[2] = teeth3;

    currentSizes[0] = 4;
    currentSizes[1] = 7;
    currentSizes[2] = 4;
  }

  else if (currentQuestion == 1) {

    showBitmap(epd_bitmap_hands);

    currentUIDs[0] = hands1;
    currentUIDs[1] = hands2;
    currentUIDs[2] = hands3;

    currentSizes[0] = 7;
    currentSizes[1] = 7;
    currentSizes[2] = 7;
  }

  else if (currentQuestion == 2) {

    showBitmap(epd_bitmap_morning);

    currentUIDs[0] = morning1;
    currentUIDs[1] = morning2;
    currentUIDs[2] = morning3;

    currentSizes[0] = 7;
    currentSizes[1] = 7;
    currentSizes[2] = 7;
  }

  else if (currentQuestion == 3) {

    showBitmap(epd_bitmap_sleep);

    currentUIDs[0] = sleep1;
    currentUIDs[1] = sleep2;
    currentUIDs[2] = sleep3;

    currentSizes[0] = 4;
    currentSizes[1] = 7;
    currentSizes[2] = 7;
  }
}
